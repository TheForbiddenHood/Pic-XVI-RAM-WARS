// Import libraries
#include <Wire.h>
#include <Adafruit_GFX.h>
#include <Adafruit_SSD1306.h>

// The OLED Screen
#define SCREEN_WIDTH 128
#define SCREEN_HEIGHT 64

// Continued Declaration for the OLED Display
#define OLED_RESET -1
Adafruit_SSD1306 display(SCREEN_WIDTH, SCREEN_HEIGHT, &Wire, OLED_RESET);

// Declare the current screen being displayed (this will help when we change button functions based on display)
#define SCREEN_COUNT 3
int currentScreen = 0;

// Button Declarations
const int buttonA = 10, buttonB = 9, buttonC = 8;

// Previous State so we can ENSURE single presses
bool lastA = LOW, lastB = LOW, lastC = LOW;

// Debounce Tracking
unsigned long lastDebounceA = 0, lastDebounceB = 0, lastDebounceC = 0;
const unsigned long DEBOUNCE_DELAY = 50;

// Previous HUD values to avoid redraws
int lastResource = -1, lastStrength = -1, lastCount = -1;

// Player HUD Declarations
int resources = 0, strength = 0, countdown = 120;

// Declarations for the CommandCenter Screen
int scvCount = 1;
unsigned long lastResourceTick = 0;
const unsigned long RESOURCE_INTERVAL = 1000;

// Declarations for the Multiplier Values (Engineering Bay)
float steroids = 1.0;
float drillsPlus = 1.0;

// Declarations for cost of units and items (makes it easier to edit)
const int scvCost = 20, scvRefund = 10;
const int marineCost = 40, marauderCost = 115;

// Declarations for insufficient currency HUD warning
bool showInsufficientFunds = false;
unsigned long insufficientFundsTimer = 0;
const unsigned long INSUFFICIENT_DURATION = 800;

// Declaration for Engagements (battles)
const int fightValues[] = { 50, 95, 175 };

// Current Game State
enum GameState { PLAYING, BATTLE_RESULT, GAME_VICTORY, GAME_DEFEAT };
GameState gameState = PLAYING;

// Tracking of the battles
int currentFight = 0;
int wins = 0;
int losses = 0;
bool battleWon = false;

// Battle Result Screen Display Duration
unsigned long battleResultTimer = 0;
const unsigned long BATTLE_RESULT_DURATION = 3000;

// Timer Value
unsigned long lastTimerTick = 0;

// Gem for Resources (Could change later)
static const unsigned char PROGMEM iconResource[] = {
  0x18, 0x3C, 0x7E, 0xFF, 0xFF, 0x7E, 0x3C, 0x18
};

// Sword for Strength 
static const unsigned char PROGMEM iconStrength[] = {
  0x18, 0x18, 0x18, 0x18, 0x7E, 0x18, 0x3C, 0x18
};

// Hourglass for Time
static const unsigned char PROGMEM iconTime[] = {
  0xFF, 0x7E, 0x3C, 0x18, 0x18, 0x3C, 0x7E, 0xFF
};

// Bitmap for Resource-Collecting Screen
const unsigned char CommandCenter [] PROGMEM = {
	0xff, 0xff, 0xff, 0xff, 0xff, 0xff, 0xff, 0xff, 0xff, 0xff, 0xff, 0xff, 0xff, 0xff, 0xff, 0xff, 
	0xff, 0xff, 0xff, 0xff, 0xff, 0xff, 0xff, 0xff, 0xff, 0xff, 0xff, 0xff, 0xff, 0xff, 0xff, 0xff, 
	0xff, 0xff, 0xff, 0xff, 0xff, 0xff, 0xff, 0xff, 0xff, 0xff, 0xff, 0xff, 0xff, 0xff, 0xff, 0xff, 
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	0xff, 0xff, 0xff, 0xff, 0xff, 0xff, 0xff, 0xff, 0xff, 0xff, 0xff, 0xff, 0xff, 0xff, 0xff, 0xff
};

// Bitmap for Upgrades Screen
const unsigned char EngineeringBay [] PROGMEM = {
	0xff, 0xff, 0xff, 0xff, 0xff, 0xff, 0xff, 0xff, 0xff, 0xff, 0xff, 0xff, 0xff, 0xff, 0xff, 0xff, 
	0xff, 0xff, 0xff, 0xff, 0xff, 0xff, 0xff, 0xff, 0xff, 0xff, 0xff, 0xff, 0xff, 0xff, 0xff, 0xff, 
	0xff, 0xff, 0xff, 0xff, 0xff, 0xff, 0xff, 0xff, 0xff, 0xff, 0xff, 0xff, 0xff, 0xff, 0xff, 0xff, 
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	0xff, 0xff, 0xff, 0xff, 0xff, 0xff, 0xff, 0xff, 0xff, 0xff, 0xff, 0xff, 0xff, 0xff, 0xff, 0xff
};

// Bitmap for the Army-Training Screen
const unsigned char Barracks [] PROGMEM = {
	0xff, 0xff, 0xff, 0xff, 0xff, 0xff, 0xff, 0xff, 0xff, 0xff, 0xff, 0xff, 0xff, 0xff, 0xff, 0xff, 
	0xff, 0xff, 0xff, 0xff, 0xff, 0xff, 0xff, 0xff, 0xff, 0xff, 0xff, 0xff, 0xff, 0xff, 0xff, 0xff, 
	0xff, 0xff, 0xff, 0xff, 0xff, 0xff, 0xff, 0xff, 0xff, 0xff, 0xff, 0xff, 0xff, 0xff, 0xff, 0xff, 
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	0xff, 0xff, 0xff, 0xff, 0xff, 0xff, 0xff, 0xff, 0xff, 0xff, 0xff, 0xff, 0xff, 0xff, 0xff, 0xff
};

// Bitmap for Splash Screen
const unsigned char Splash [] PROGMEM = {
	0xff, 0xff, 0xff, 0xff, 0xff, 0xff, 0xff, 0xff, 0xff, 0xff, 0xff, 0xff, 0xff, 0xff, 0xff, 0xff, 
	0xff, 0xff, 0xff, 0xff, 0xff, 0xff, 0xff, 0xff, 0xff, 0xff, 0xff, 0xff, 0xff, 0xff, 0xff, 0xff, 
	0xff, 0xfe, 0x09, 0x91, 0xe6, 0xdd, 0x3f, 0x83, 0xce, 0x79, 0xe6, 0x72, 0x30, 0x70, 0xff, 0xff, 
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	0xff, 0xff, 0xff, 0xff, 0xff, 0xff, 0xff, 0xff, 0xff, 0xff, 0xff, 0xff, 0xff, 0xff, 0xff, 0xff
};

// Bitmap for the BattleScene Screen
const unsigned char BattleScene [] PROGMEM = {
	0xff, 0xff, 0xff, 0xff, 0xff, 0xff, 0xff, 0xff, 0xff, 0xff, 0xff, 0xff, 0xff, 0xff, 0xff, 0xff, 
	0xff, 0xff, 0xff, 0xff, 0xff, 0xff, 0xff, 0xff, 0xff, 0xff, 0xff, 0xff, 0xff, 0xff, 0xff, 0xff, 
	0xff, 0xff, 0xff, 0xff, 0xff, 0xff, 0xff, 0xff, 0xff, 0xff, 0xff, 0xff, 0xff, 0xff, 0xff, 0xff, 
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	0xff, 0xff, 0xff, 0xff, 0xff, 0xff, 0xff, 0xff, 0xff, 0xff, 0xff, 0xff, 0xff, 0xff, 0xff, 0xff
};

// Bitmap for the Victory Screen
const unsigned char VictoryScreen [] PROGMEM = {
	0xff, 0xff, 0xff, 0xff, 0xff, 0xff, 0xff, 0xff, 0xff, 0xff, 0xff, 0xff, 0xff, 0xff, 0xff, 0xff, 
	0xff, 0xff, 0xff, 0xff, 0xff, 0xff, 0xff, 0xff, 0xff, 0xff, 0xff, 0xff, 0xff, 0xff, 0xff, 0xff, 
	0xff, 0xff, 0xff, 0xff, 0xff, 0xff, 0xff, 0xff, 0xff, 0xff, 0xff, 0xff, 0xff, 0xff, 0xff, 0xff, 
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	0xff, 0xff, 0xff, 0xff, 0xff, 0xff, 0xff, 0xff, 0xff, 0xff, 0xff, 0xff, 0xff, 0xff, 0xff, 0xff
};

// Bitmap for the Defeat Screen
const unsigned char DefeatScreen [] PROGMEM = {
	0xff, 0xff, 0xff, 0xff, 0xff, 0xff, 0xff, 0xff, 0xff, 0xff, 0xff, 0xff, 0xff, 0xff, 0xff, 0xff, 
	0xff, 0xff, 0xff, 0xff, 0xff, 0xff, 0xff, 0xff, 0xff, 0xff, 0xff, 0xff, 0xff, 0xff, 0xff, 0xff, 
	0xff, 0xff, 0xff, 0xff, 0xff, 0xff, 0xff, 0xff, 0xff, 0xff, 0xff, 0xff, 0xff, 0xff, 0xff, 0xff, 
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	0xff, 0xff, 0xff, 0xff, 0xff, 0xff, 0xff, 0xff, 0xff, 0xff, 0xff, 0xff, 0xff, 0xff, 0xff, 0xff
};

// Array of pointers to each screen's bitmap
const unsigned char* const screens[] = {
  CommandCenter, Barracks, EngineeringBay
};

// Function keeps track of SCV count and the resource collection rate
void updateResources() {
  // Time
  unsigned long now = millis();

  if (now - lastResourceTick >= RESOURCE_INTERVAL) {
    resources = min(resources + (int)(scvCount * drillsPlus), 999);
    lastResourceTick = now;
  }
}

// Function that operates the timer at the top right of the player HUD + in charge of triggering battles at the end of a phase
void updateCountdown() {
	if (gameState != PLAYING) return;

	unsigned long now = millis();
	if (now - lastTimerTick >= 1000) {
		lastTimerTick = now;
		countdown--;
		if (countdown <= 0) {
			triggerBattle();
		}
	}
}

// Function that displays a "!" when the player attempts to make a purchase without insufficient funds
void flashInsufficient() {
	showInsufficientFunds = true;
	insufficientFundsTimer = millis();
}

// Function creates and draws up the player HUD at the top of the OLED screen
void updateHUD() {

  // Draw up our icons on the HUD
  display.drawBitmap(2, 3, iconResource, 8, 8, WHITE);
  display.drawBitmap(44, 3, iconStrength, 8, 8, WHITE);
  display.drawBitmap(87, 3, iconTime, 8, 8, WHITE);

  // Values for the HUD
  display.setTextSize(1);
  display.setTextColor(WHITE, BLACK);

	// Check to see if the insufficient funds timer has run out
	if (showInsufficientFunds && millis() - insufficientFundsTimer >= INSUFFICIENT_DURATION) {
		showInsufficientFunds = false;
	}

	// Wipe old value for resources to ensure we don't leave artifacts
	display.fillRect(11, 3, 18, 8, BLACK);

  // Display our resource stat
  display.setCursor(11, 3);
  display.print(resources);

	// Display the insufficient funds timer IF need be past the XXX digit in resources
	display.fillRect(29, 3, 6, 8, BLACK);
	if (showInsufficientFunds) { display.setCursor(29, 3); display.print("!"); }

  // Display our strength stat
  display.setCursor(53, 3);
  display.print((int)(strength * steroids));

  // Display our current time
	display.fillRect(96, 3, 18, 8, BLACK);
  display.setCursor(96, 3);
  display.print(countdown);

  // Create a line between the HUD and the game screen
  display.drawFastHLine(0, 15, SCREEN_WIDTH, WHITE);
}

// Function creates and draws up the current screen underneath the HUD 
void drawGameScreen() {

  // First, we'll wipe whatever was previously on the game screen
  display.fillRect(0, 16, SCREEN_WIDTH, 48, BLACK);

  // Second, we'll draw up the new screen to display
  display.drawBitmap(0, 16, screens[currentScreen], 128, 48, WHITE);

  // Third, print stats in BLACK ontop of the WHITE background
  display.setTextSize(1);
  display.setTextColor(BLACK);

  // Fourth, print BASED on what screen we're displaying

  // CommandCenter Screen
  if (currentScreen == 0) {

    // SCVs
    display.setCursor(60, 20);
    display.print("MNR: ");
    display.print(scvCount);

    // Controls Display
    display.setCursor(60, 40);
    display.print("B +MNR (20)");
    display.setCursor(60, 50);
    display.print("C -MNR (+10)");

    // Barracks Screen
  } else if (currentScreen == 1) {

    // Controls Display
    display.setCursor(60, 30);
    display.print("B MAR (40)");
    display.setCursor(60, 50);
    display.print("C MDR (115)");

    // EngineeringBay Screen
  } else if (currentScreen == 2) {

    // Steroids Value
    display.setCursor(60, 20);
    display.print("ROID: ");
    display.print((int)(steroids * 100));
    display.print("%");

    // Drill Value
    display.setCursor(60, 30);
    display.print("DRIL: ");
    display.print((int)(drillsPlus * 100));
    display.print("%");

    // Controls Display
    display.setCursor(60, 40);
    display.print("B ROID (50)");
    display.setCursor(60, 50);
    display.print("C DRIL (50)");

  }
}

// Function pushes the full buffer to the screen, and we'll call it once per frame
void renderFrame() {
  display.display();
}

// Function for the starting menu PRIOR to game START.
void drawSplashScreen() {
	display.clearDisplay();
	display.drawBitmap(0, 0, Splash, 128, 64, WHITE);
	display.display();
	delay(5000); // How long the Splash stays on the screen
	display.clearDisplay();
}

// Function that handles the battle / game logic
void triggerBattle() {
	int effectiveStrength = (int)(strength * steroids);
	int enemy = fightValues[currentFight];

	if (effectiveStrength >= enemy) {
		battleWon = true;
		wins++;
		strength = max(effectiveStrength - enemy, 0);
		steroids = 1.0;
	} else {
		battleWon = false;
		losses++;
		strength = 0;
		steroids = 1.0;
	}

	//Advance to next battle
	currentFight = min(currentFight + 1, 2);
	countdown = 120;

	if (wins >= 2) {
		gameState = GAME_VICTORY;
		drawEndScreen(true);
	} else if (losses >= 2) {
		gameState = GAME_DEFEAT;
		drawEndScreen(false);
	} else {
		gameState = BATTLE_RESULT;
		drawBattleResult();
	}

	battleResultTimer = millis();
}

// Function that draws the BattleScene w/ result text on top of it.
void drawBattleResult() {
	display.clearDisplay();
	display.drawBitmap(0, 0, BattleScene, 128, 64, WHITE);

	display.setTextSize(1);
	display.setTextColor(BLACK);

	if (battleWon) {
		display.setCursor(14, 20);
		display.print("BATTLE");
		display.setCursor(22, 42);
		display.print("WON");
	} else {
		display.setCursor(14, 20);
		display.print("BATTLE");
		display.setCursor(22, 42);
		display.print("LOST");
	}

	display.display();
}

// Function that draws the FINAL game end screen
void drawEndScreen(bool victory) {
	display.clearDisplay();

	display.setTextSize(2);
	display.setTextColor(WHITE);

	if (victory) {
	display.drawBitmap(0, 0, VictoryScreen, 128, 64, WHITE);
	} else {
	display.drawBitmap(0, 0, DefeatScreen, 128, 64, WHITE);
	}

	display.display();
}

void setup() {
  Serial.begin(115200);

  // Declare buttons as inputs for the Arduino
  pinMode(buttonA, INPUT);
  pinMode(buttonB, INPUT);
  pinMode(buttonC, INPUT);

	// Create our way of keeping track of time
  Wire.begin();
  Wire.setClock(400000);

	// Start the Display
  display.begin(SSD1306_SWITCHCAPVCC, 0x3C);

	// Draw the splash screen before game start
	drawSplashScreen();

	// Call all functions once to intialize them on game start
  display.clearDisplay();

	lastTimerTick = millis();
  updateHUD();
  drawGameScreen();
  renderFrame();

}

void loop() {
  updateResources();
	updateCountdown();

	// Flag bools if the buttons have been pressed
  bool a = digitalRead(buttonA) == HIGH;
  bool b = digitalRead(buttonB) == HIGH;
  bool c = digitalRead(buttonC) == HIGH;

	if (gameState == BATTLE_RESULT) {
		if (millis() - battleResultTimer >= BATTLE_RESULT_DURATION) {
			gameState = PLAYING;
			display.clearDisplay();
			updateHUD();
			drawGameScreen();
			renderFrame();
		}
		lastA = a; lastB = b; lastC = c;
		return;
	}

	if (gameState == GAME_VICTORY || gameState == GAME_DEFEAT) {
		lastA = a; lastB = b; lastC = c;
		return;
	}

  unsigned long now = millis();
  bool changed = false;

  // Button A ALWAYS will change screens
  if (a && !lastA && (now - lastDebounceA >= DEBOUNCE_DELAY)) { currentScreen = (currentScreen + 1) % SCREEN_COUNT; lastDebounceA = now; changed = true; }

  // Button B and C are screen-dependent, so we update their uses based on the currentScreen !!!

	// CommandCenter Screen
  if (currentScreen == 0) {
    if (b && !lastB && (now - lastDebounceB >= DEBOUNCE_DELAY)) {
      if (resources >= scvCost) { resources -= scvCost; scvCount++; changed = true; } else { flashInsufficient(); } lastDebounceB = now;
    }
    if (c && !lastC && (now - lastDebounceC >= DEBOUNCE_DELAY)) {
      if (scvCount > 1) {scvCount--; resources = min(resources + scvRefund, 999); changed = true; } lastDebounceC = now;
    }

	// Barracks Screen
  } else if (currentScreen == 1) {
    if (b && !lastB && (now - lastDebounceB >= DEBOUNCE_DELAY)) {
      if (resources >= marineCost) { resources -= marineCost; strength = min(strength + 1, 999); changed = true; } else { flashInsufficient(); } lastDebounceB = now;
    }
    if (c && !lastC && (now - lastDebounceC >= DEBOUNCE_DELAY)) {
      if (resources >= marauderCost) { resources -= marauderCost; strength = min(strength + 3, 999); changed = true; } else { flashInsufficient(); } lastDebounceC = now;
    } 

	// EngineeringBay Screen
  } else if (currentScreen == 2) {
    if (b && !lastB && (now - lastDebounceB >= DEBOUNCE_DELAY)) { if (resources >= 50) { resources -= 50; steroids += 0.1; changed = true; } else { flashInsufficient(); } lastDebounceB = now;
    }
    if (c && !lastC && (now - lastDebounceC >= DEBOUNCE_DELAY)) { if (resources >= 50) { resources -= 50; drillsPlus += 0.1; changed = true; } else { flashInsufficient(); } lastDebounceC = now;
    }
  }

  // Update last statuses
  lastA = a;
  lastB = b;
  lastC = c;

  if (changed || showInsufficientFunds || resources != lastResource || strength != lastStrength || countdown != lastCount) {

    updateHUD();
    drawGameScreen();
    renderFrame();

    lastResource = resources;
    lastStrength = strength;
    lastCount = countdown;
  }
}
